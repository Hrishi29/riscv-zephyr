## dts/bindings/clock/sifive,freedome300prci0.yaml
```yaml
#
# Copyright (c) 2018, SiFive Inc.
#
# SPDX-License-Identifier: Apache-2.0
#
---
title: Generic SiFive PRCI (Power, Reset, Clocking, Interrupt) Controller
id: sifive,freedome300prci0
version: 0.1

description: >
    Configuration registers for power, reset, clocking, and interrupts

properties:

    compatible:
      type: string
      category: required
      description: compatible strings
      constraint: "sifive,freedome300prci0"
      generation: define

    reg:
      type: array
      description: mmio register space
      generation: define
      category: required

...
```
